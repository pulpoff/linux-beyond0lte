## drivers/iio/common/bcm4775_shub/Kconfig
```kconfig
# SPDX-License-Identifier: GPL-2.0-only
config IIO_BCM4775_SHUB
	tristate "Broadcom BCM4775 sensor hub (Samsung SSP)"
	depends on SPI && OF
	select FW_LOADER
	select IIO_BUFFER
	select IIO_TRIGGERED_BUFFER
	help
	  The BCM4775 GNSS/sensor hub in Samsung Galaxy S10 phones. It needs
	  a RAM patch (brcm/bcm4775-shub.patch) on every power-up. The
	  accelerometer, light, proximity and compass it runs are exposed
	  as IIO devices.

	  To compile this driver as a module, choose M here: the module
	  will be called bcm4775-shub.
```

## drivers/media/platform/samsung/exynos9820-csis/Kconfig
```kconfig
# SPDX-License-Identifier: GPL-2.0-only
config VIDEO_EXYNOS9820_CSIS
	tristate "Exynos 9820 MIPI CSI-2 receiver"
	depends on V4L_PLATFORM_DRIVERS
	depends on VIDEO_DEV && OF
	depends on ARCH_EXYNOS || COMPILE_TEST
	select MEDIA_CONTROLLER
	select VIDEO_V4L2_SUBDEV_API
	select V4L2_FWNODE
	select VIDEOBUF2_DMA_CONTIG
	help
	  The camera receiver of the Exynos 9820 (Galaxy S10 family): the
	  CSIS v5.2 links and their write DMAs, giving raw Bayer frames to
	  memory for a software ISP such as libcamera's.
```
